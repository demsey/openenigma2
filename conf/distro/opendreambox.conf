## conf/distro/opendreambox.conf
```bitbake
#@TYPE: Distribution
#@NAME: OpenDreambox
#@DESCRIPTION: Distribution configuration for OpenDreambox

INHERIT += "opendreambox-mirrors"
INHERIT += "package_ipk debian"
INHERIT += "packaged-staging"

SYSVINIT_ENABLED_GETTYS = ""
DISTRO = "opendreambox"
DISTRO_NAME = "OpenDreambox"
DISTRO_VERSION = "1.6.0"
DISTRO_PR = ""

# for image.bbclass:
IMAGE_DEV_MANAGER ?= "udev"
IMAGE_INIT_MANAGER ?= "sysvinit"
IMAGE_INITSCRIPTS ?= "initscripts-opendreambox"
IMAGE_LOGIN_MANAGER ?= ""
IMAGE_FSTYPES ?= "tar.bz2 jffs2"

# for rootfs_ipk.bbclass:
IPKG_VARIANT = "opkg-nogpg"

# for dreambox-feed-configs:
DISTRO_FEED_URI = "http://sources.dreamboxupdate.com/${DISTRO}/1.6/experimental"

SRCDATE = 20070625

# for sane-toolchain.inc:
LIBC ?= "eglibc"
PREFERRED_BINUTILS ?= "2.20"
PREFERRED_GCC_VERSION ?= "4.4.3"
TARGET_VENDOR ?= ""

PREFERRED_VERSION_automake ?= "1.10.2"
PREFERRED_VERSION_automake-native ?= "1.10.2"
PREFERRED_VERSION_busybox ?= "1.13.2"
PREFERRED_VERSION_libsigc++-1.2 ?= "1.2.5"
PREFERRED_VERSION_linux-libc-headers ?= "2.6.29"
PREFERRED_VERSION_swig-native ?= "1.3.39"
PREFERRED_VERSION_wpa-supplicant ?= "0.6.9"
PREFERRED_VERSION_samba = "3.2.8"

PREFERRED_PROVIDER_avahi = "avahi"
PREFERRED_PROVIDER_opkg = "opkg-nogpg"
PREFERRED_PROVIDER_initscripts = "initscripts-opendreambox"
PREFERRED_PROVIDER_virtual/db = "db"
PREFERRED_PROVIDER_virtual/db-native = "db-native"
PREFERRED_PROVIDER_bluez-libs = "bluez-libs"
PREFERRED_PROVIDER_libfribidi = "libfribidi"

require conf/distro/include/sane-srcdates.inc
require conf/distro/include/sane-srcrevs.inc
require conf/distro/include/sane-toolchain.inc
require conf/distro/include/sane-feed-ipk.inc
```

## conf/machine/dm500hd.conf
```bitbake
#@TYPE: Machine
#@NAME: Dreambox DM500HD
#@DESCRIPTION: Machine configuration for the Dreambox DM500HD

#comment out the following two lines to use currently experimental kernel 2.6.3x
PREFERRED_VERSION_linux-dm500hd = "2.6.18"
PREFERRED_VERSION_linux-libc-headers = "2.6.18"
PREFERRED_VERSION_wpa-supplicant = "0.5.10"

#needed for wpa-supplicant (0.6.9)
COMBINED_FEATURES_append = "${@base_contains('PREFERRED_VERSION_linux-dm800', '2.6.18', '', 'nl80211', d)}"

#take care when you do changes on MACHINE_ESSENTIAL_EXTRA_RDEPENDS/RRECOMMENDS you have to increment the recipes/tasks/task-boot.bb PR

MACHINE_ESSENTIAL_EXTRA_RDEPENDS_2.6.18 = "\
	kernel-module-nls-iso8859-1 \
	kernel-module-nls-cp437 \
	kernel-module-nls-cp850 \
	kernel-module-nls-utf8 \
"

MACHINE_ESSENTIAL_EXTRA_RRECOMMENDS_2.6.18 = "\
	kernel-module-cifs \
	kernel-module-exportfs \
	kernel-module-ext2 \
	kernel-module-reiserfs \
	kernel-module-xfs \
"

MACHINE_ESSENTIAL_EXTRA_RDEPENDS_2.6.3x = "\
	kernel-module-autofs4 \
	kernel-module-dvb-core \
	kernel-module-fb \
	kernel-module-sg \
	kernel-module-snd-pcm \
	kernel-module-snd \
	kernel-module-sr-mod \
	kernel-module-stv0299 \
	kernel-module-usbhid \
"

MACHINE_ESSENTIAL_EXTRA_RRECOMMENDS_2.6.3x = "\
	kernel-module-cdrom \
	kernel-module-cifs \
	kernel-module-exportfs \
	kernel-module-ext2 \
	kernel-module-reiserfs \
	kernel-module-xfs \
"

MACHINE_ESSENTIAL_EXTRA_RDEPENDS = ${@base_contains('PREFERRED_VERSION_linux-dm500hd', '2.6.18', '${MACHINE_ESSENTIAL_EXTRA_RDEPENDS_2.6.18}', '${MACHINE_ESSENTIAL_EXTRA_RDEPENDS_2.6.3x}', d)}
MACHINE_ESSENTIAL_EXTRA_RRECOMMENDS = ${@base_contains('PREFERRED_VERSION_linux-dm500hd', '2.6.18', '${MACHINE_ESSENTIAL_EXTRA_RRECOMMENDS_2.6.18}', '${MACHINE_ESSENTIAL_EXTRA_RRECOMMENDS_2.6.3x}', d)}

KERNEL_EXTRA_CMD = ${@base_contains('PREFERRED_VERSION_linux-dm500hd', '2.6.18', '--disable-compressor=lzo ', '', d)}

EXTRA_IMAGECMD_jffs2 = " --eraseblock=0x4000 -n -l "
IMAGE_CMD_jffs2 = "\
	mkfs.jffs2 \
		--root=${IMAGE_ROOTFS}/boot \
		--faketime \
		--disable-compressor=lzo \
		--compression-mode=size \
		--output=${DEPLOY_DIR_IMAGE}/${IMAGE_NAME}.boot.jffs2 \
		${EXTRA_IMAGECMD}; \
	rm -rf ${IMAGE_ROOTFS}/boot/*; \
	mkfs.jffs2 \
		--root=${IMAGE_ROOTFS} \
		--faketime \
		${KERNEL_EXTRA_CMD} \
		--compression-mode=size \
		--output=${DEPLOY_DIR_IMAGE}/${IMAGE_NAME}.rootfs.jffs2 \
		${EXTRA_IMAGECMD}; \
	buildimage ${STAGING_LIBDIR}/dreambox-secondstage/main.bin.gz \
		${DEPLOY_DIR_IMAGE}/${IMAGE_NAME}.boot.jffs2 \
		${DEPLOY_DIR_IMAGE}/${IMAGE_NAME}.rootfs.jffs2 \
		${MACHINE} 64 \
		> ${DEPLOY_DIR_IMAGE}/${IMAGE_NAME}.nfi"

GLIBC_EXTRA_OECONF = "--disable-profile --with-tls --with-__thread"
TARGET_FPU = "hard"

MACHINE_FEATURES += "modem"

require conf/machine/include/dreambox-mipsel.inc
```

## conf/machine/dm500plus.conf
```bitbake
#@TYPE: Machine
#@NAME: Dreambox DM 500+
#@DESCRIPTION: Machine configuration for the Dreambox DM 500+

require conf/machine/include/dreambox-powerpc.inc
```

## conf/machine/dm600pvr.conf
```bitbake
#@TYPE: Machine
#@NAME: Dreambox DM 600 PVR
#@DESCRIPTION: Machine configuration for the Dreambox DM 600 PVR

require conf/machine/include/dreambox-powerpc.inc
```

## conf/machine/dm7020.conf
```bitbake
#@TYPE: Machine
#@NAME: Dreambox DM 7020
#@DESCRIPTION: Machine configuration for the Dreambox DM 7020

require conf/machine/include/dreambox-powerpc.inc

IMAGE_CMD_jffs2 = "mkfs.jffs2 --root=${IMAGE_ROOTFS}/boot --faketime -x lzo \
       --output=${DEPLOY_DIR_IMAGE}/${IMAGE_NAME}.boot.jffs2 \
       ${EXTRA_IMAGECMD}; rm -rf ${IMAGE_ROOTFS}/boot/*; \
				mkfs.jffs2 --root=${IMAGE_ROOTFS} --faketime -x lzo \
       --output=${DEPLOY_DIR_IMAGE}/${IMAGE_NAME}.rootfs.jffs2 \
       ${EXTRA_IMAGECMD}; \
       buildimage ${STAGING_LIBDIR}/dreambox-secondstage/main.bin.gz \
       ${DEPLOY_DIR_IMAGE}/${IMAGE_NAME}.boot.jffs2 \
       ${DEPLOY_DIR_IMAGE}/${IMAGE_NAME}.rootfs.jffs2 \
       > ${DEPLOY_DIR_IMAGE}/${IMAGE_NAME}.nfi"
```

## conf/machine/dm7025.conf
```bitbake
#@TYPE: Machine
#@NAME: Dreambox DM 7025
#@DESCRIPTION: Machine configuration for the Dreambox DM 7025

MACHINE_ESSENTIAL_EXTRA_RDEPENDS = "\
	kernel-module-pata-xilleon \
"

EXTRA_IMAGECMD_jffs2 = " --eraseblock=0x4000 -n -l "
IMAGE_CMD_jffs2 = "\
	mkfs.jffs2 \
		--root=${IMAGE_ROOTFS}/boot \
		--faketime \
		--disable-compressor=lzo \
		--compression-mode=size \
		--output=${DEPLOY_DIR_IMAGE}/${IMAGE_NAME}.boot.jffs2 \
		${EXTRA_IMAGECMD}; \
	rm -rf ${IMAGE_ROOTFS}/boot/*; \
	mkfs.jffs2 \
		--root=${IMAGE_ROOTFS} \
		--faketime \
		--compression-mode=size \
		--output=${DEPLOY_DIR_IMAGE}/${IMAGE_NAME}.rootfs.jffs2 \
		${EXTRA_IMAGECMD}; \
	buildimage ${STAGING_LIBDIR}/dreambox-secondstage/main.bin.gz \
		${DEPLOY_DIR_IMAGE}/${IMAGE_NAME}.boot.jffs2 \
		${DEPLOY_DIR_IMAGE}/${IMAGE_NAME}.rootfs.jffs2 \
		${MACHINE} \
		> ${DEPLOY_DIR_IMAGE}/${IMAGE_NAME}.nfi"

require conf/machine/include/dreambox-mipsel.inc
```

## conf/machine/dm800.conf
```bitbake
#@TYPE: Machine
#@NAME: Dreambox DM 800 HD PVR
#@DESCRIPTION: Machine configuration for the Dreambox DM 800 HD PVR

#comment out the following three lines to use currently experimental kernel 2.6.3x
PREFERRED_VERSION_linux-dm800 = "2.6.18"
PREFERRED_VERSION_linux-libc-headers = "2.6.18"
PREFERRED_VERSION_wpa-supplicant = "0.5.10"

#needed for wpa-supplicant (0.6.9)
COMBINED_FEATURES_append = "${@base_contains('PREFERRED_VERSION_linux-dm800', '2.6.18', '', 'nl80211', d)}"

MACHINE_ESSENTIAL_EXTRA_RDEPENDS_2.6.18 = "\
	kernel-module-cifs \
	kernel-module-cdfs \
	kernel-module-exportfs \
	kernel-module-ext2 \
	kernel-module-reiserfs \
	kernel-module-xfs \
"

MACHINE_ESSENTIAL_EXTRA_RDEPENDS_2.6.3x = "\
	kernel-module-autofs4 \
	kernel-module-cdrom \
	kernel-module-cifs \
	kernel-module-dvb-core \
	kernel-module-exportfs \
	kernel-module-ext2 \
	kernel-module-fb \
	kernel-module-isofs \
	kernel-module-reiserfs \
	kernel-module-sg \
	kernel-module-snd-pcm \
	kernel-module-snd \
	kernel-module-sr-mod \
	kernel-module-stv0299 \
	kernel-module-usbhid \
	kernel-module-xfs \
"

MACHINE_ESSENTIAL_EXTRA_RDEPENDS = ${@base_contains('PREFERRED_VERSION_linux-dm800', '2.6.18', '${MACHINE_ESSENTIAL_EXTRA_RDEPENDS_2.6.18}', '${MACHINE_ESSENTIAL_EXTRA_RDEPENDS_2.6.3x}', d)}

KERNEL_EXTRA_CMD = ${@base_contains('PREFERRED_VERSION_linux-dm800', '2.6.18', '--disable-compressor=lzo ', '', d)}

EXTRA_IMAGECMD_jffs2 = " --eraseblock=0x4000 -n -l "
IMAGE_CMD_jffs2 = "\
	mkfs.jffs2 \
		--root=${IMAGE_ROOTFS}/boot \
		--faketime \
		--disable-compressor=lzo \
		--compression-mode=size \
		--output=${DEPLOY_DIR_IMAGE}/${IMAGE_NAME}.boot.jffs2 \
		${EXTRA_IMAGECMD}; \
	rm -rf ${IMAGE_ROOTFS}/boot/*; \
	mkfs.jffs2 \
		--root=${IMAGE_ROOTFS} \
		--faketime \
		${KERNEL_EXTRA_CMD} \
		--compression-mode=size \
		--output=${DEPLOY_DIR_IMAGE}/${IMAGE_NAME}.rootfs.jffs2 \
		${EXTRA_IMAGECMD}; \
	buildimage ${STAGING_LIBDIR}/dreambox-secondstage/main.bin.gz \
		${DEPLOY_DIR_IMAGE}/${IMAGE_NAME}.boot.jffs2 \
		${DEPLOY_DIR_IMAGE}/${IMAGE_NAME}.rootfs.jffs2 \
		${MACHINE} 64 \
		> ${DEPLOY_DIR_IMAGE}/${IMAGE_NAME}.nfi"

require conf/machine/include/dreambox-mipsel.inc
```

## conf/machine/dm8000.conf
```bitbake
#@TYPE: Machine
#@NAME: Dreambox DM 8000 HD PVR
#@DESCRIPTION: Machine configuration for the Dreambox DM 8000 HD PVR

MACHINE_ESSENTIAL_EXTRA_RDEPENDS = "\
	kernel-module-exportfs \
	kernel-module-reiserfs \
	kernel-module-sd-mod \
	kernel-module-sg \
	kernel-module-sr-mod \
	kernel-module-usbhid \
	kernel-module-usbmon \
	kernel-module-xfs"

EXTRA_IMAGECMD_jffs2 = " --eraseblock=0x20000 -n -l "
IMAGE_CMD_jffs2 = "mkfs.jffs2 --root=${IMAGE_ROOTFS}/boot --faketime -x lzo \
       --output=${DEPLOY_DIR_IMAGE}/${IMAGE_NAME}.boot.jffs2 \
       ${EXTRA_IMAGECMD}; rm -rf ${IMAGE_ROOTFS}/boot/*; \
				mkfs.jffs2 --root=${IMAGE_ROOTFS} --faketime -x lzo \
       --output=${DEPLOY_DIR_IMAGE}/${IMAGE_NAME}.rootfs.jffs2 \
       ${EXTRA_IMAGECMD}; \
       buildimage ${STAGING_LIBDIR}/dreambox-secondstage/main.bin.gz \
       ${DEPLOY_DIR_IMAGE}/${IMAGE_NAME}.boot.jffs2 \
       ${DEPLOY_DIR_IMAGE}/${IMAGE_NAME}.rootfs.jffs2 \
       ${MACHINE} 64 large \
       > ${DEPLOY_DIR_IMAGE}/${IMAGE_NAME}.nfi"

require conf/machine/include/dreambox-mipsel.inc
```

## conf/machine/include/dreambox-mipsel.inc
```bitbake
# dreambox-mipsel.inc

MACHINE_FEATURES += "alsa pci"

OLDEST_KERNEL = "2.6.12"

PREFERRED_PROVIDER_task-opendreambox-dvbapi = "task-opendreambox-dvbapi3"
PREFERRED_PROVIDER_task-opendreambox-ui = "task-opendreambox-enigma2"

TARGET_ARCH = "mipsel"
TARGET_FPU ?= "soft"

DISTRO_FEATURES += " mplt"

require conf/machine/include/dreambox.inc
require conf/machine/include/tune-mips32.inc
```

## conf/machine/include/dreambox-powerpc.inc
```bitbake
# dreambox-powerpc.inc

PACKAGE_EXTRA_ARCHS = "ppc405"

PREFERRED_VERSION_gdb = "6.5"
PREFERRED_VERSION_gdb-cross = "6.5"
PREFERRED_VERSION_freetype = "2.0.9"

TARGET_ARCH = "powerpc"
TARGET_CPU = "405"

EXTRA_IMAGECMD_jffs2 = " --eraseblock=0x4000 -n -b "
IMAGE_CMD_jffs2 = "mkfs.jffs2 --root=${IMAGE_ROOTFS}/boot --faketime -x lzo \
       --output=${DEPLOY_DIR_IMAGE}/${IMAGE_NAME}.boot.jffs2 \
       ${EXTRA_IMAGECMD}; rm -rf ${IMAGE_ROOTFS}/boot/*; \
				mkfs.jffs2 --root=${IMAGE_ROOTFS} --faketime -x lzo \
       --output=${DEPLOY_DIR_IMAGE}/${IMAGE_NAME}.rootfs.jffs2 \
       ${EXTRA_IMAGECMD}; \
       buildimage ${STAGING_LIBDIR}/dreambox-secondstage/main.bin.gz \
       ${DEPLOY_DIR_IMAGE}/${IMAGE_NAME}.boot.jffs2 \
       ${DEPLOY_DIR_IMAGE}/${IMAGE_NAME}.rootfs.jffs2 \
       ${MACHINE} \
       > ${DEPLOY_DIR_IMAGE}/${IMAGE_NAME}.nfi"

require conf/machine/include/dreambox.inc
require conf/machine/include/tune-ppc405.inc
```

## conf/machine/include/dreambox.inc
```bitbake
# dreambox.inc

EXTRA_IMAGEDEPENDS += "dreambox-secondstage dreambox-buildimage-native"

GLIBC_ADDONS ?= "ports,nptl,libidn"
GLIBC_EXTRA_OECONF ?= "--disable-profile --with-tls --without-fp --with-__thread"

MACHINE_ESSENTIAL_EXTRA_RDEPENDS += "dreambox-dvb-modules"
MACHINE_FEATURES += "kernel26"

PREFERRED_PROVIDER_virtual/kernel = "linux-${MACHINE}"
PREFERRED_PROVIDER_xserver = "xserver-kdrive"
```
